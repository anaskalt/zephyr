## drivers/eeprom/Kconfig.st25dv
```kconfig
# Copyright (c) 2026 Anastasios Kaltakis
# SPDX-License-Identifier: Apache-2.0

config EEPROM_ST25DV
	bool "ST25DV dynamic NFC tag EEPROM driver"
	default y
	depends on DT_HAS_ST_ST25DV_ENABLED
	select I2C
	select GPIO if $(dt_compat_any_has_prop,$(DT_COMPAT_ST_ST25DV),gpo-gpios)
	select GPIO if $(dt_compat_any_has_prop,$(DT_COMPAT_ST_ST25DV),vcc-gpios)
	help
	  Enable the driver for the STMicroelectronics ST25DV04K/16K/64K and
	  ST25DV04KC/16KC/64KC dynamic NFC tags. The user memory is exposed
	  through the EEPROM API; GPO events, the security session, system and
	  dynamic registers and the mailbox through the ST25DV vendor API.

if EEPROM_ST25DV

config EEPROM_ST25DV_INIT_PRIORITY
	int "ST25DV init priority"
	default EEPROM_INIT_PRIORITY
	help
	  Device driver initialization priority. Must be later than the I2C
	  bus and GPIO controllers it uses.

config EEPROM_ST25DV_I2C_PASSWORD
	string "I2C security session password (16 hex digits)"
	default "0000000000000000"
	help
	  64-bit I2C password presented when the driver needs the I2C security
	  session (system register writes such as the GPO configuration). The
	  factory value is all zeros.

config EEPROM_ST25DV_EVENT_SETTLE_MS
	int "Delay between a GPO pulse and the IT_STS_Dyn read (ms)"
	default 20
	range 1 1000
	help
	  A reader session produces bursts of GPO pulses. The interrupt status
	  register accumulates every event until it is read, so the driver
	  waits this long after the last pulse before reading it and calling
	  the event callback once with all pending events.

config EEPROM_ST25DV_FIELD_TIMEOUT_S
	int "Maximum time the tag is kept powered after an RF field appeared (s)"
	default 15
	range 1 600
	help
	  The tag only reports the disappearance of the RF field while VCC is
	  present, so the driver keeps VCC on from FIELD_RISING until
	  FIELD_FALLING. If no FIELD_FALLING arrives within this time the
	  driver polls the field state and releases the power itself.

endif # EEPROM_ST25DV
```

## drivers/modem/simcom/sim7022/Kconfig
```kconfig
# SIMCom SIM7022 driver options
#
# Copyright (c) 2025 Metratec GmbH
# SPDX-License-Identifier: Apache-2.0

config MODEM_SIM7022
	bool "SIM7022 NB-IoT Driver"
	select MODEM_CONTEXT
	select MODEM_CMD_HANDLER
	select MODEM_IFACE_UART
	select MODEM_SOCKET
	select NET_OFFLOAD
	select NET_SOCKETS_OFFLOAD
	imply GPIO
	help
	  Enables the driver for the SIMCom SIM7022 NB-IoT modem.

if MODEM_SIM7022

config MODEM_SIMCOM_SIM7022_RX_STACK_SIZE
	int "Stack size for the SIM7022 modem driver RX thread"
	default 1028
	help
	  This stack is used by the SIM7022 RX thread.

config MODEM_SIMCOM_SIM7022_RX_WORKQ_STACK_SIZE
	int "Stack size for the SIM7022 modem driver work queue"
	default 2048
	help
	  This stack is used by the SIM7022 work queue.

config MODEM_SIMCOM_SIM7022_INIT_PRIORITY
	int "SIM7022 driver init priority"
	default 80
	help
	  SIM7022 driver initialization priority.

config MODEM_SIMCOM_SIM7022_APN
	string "APN for establishing a network connection"
	default "internet"
	help
	  APN name for the network connection context. This value is
	  specific to the network provider and may need to be changed.

config MODEM_SIMCOM_SIM7022_APN_MAX_LEN
	int
	default 63
	help
	  Maximum APN string length per 3GPP TS 23.003 §9.1.

config MODEM_SIMCOM_SIM7022_BAUDRATE
	int "Baudrate for modem UART"
	default 115200
	help
	  Set this to the baudrate the UART is using. On first startup
	  the modem uses autobaud. The driver will configure a fixed
	  baudrate for faster subsequent startups.

config MODEM_SIMCOM_SIM7022_LTE_BANDS
	hex "LTE NB-IoT band bitmask (AT+CNBP value)"
	default 0x0002000000400180
	help
	  64-bit hex bitmask passed verbatim to AT+CNBP to select NB-IoT bands.
	  Bit N (0-based) enables LTE band (N+1).

	  The default value 0x0002000000400180 is the example given in the
	  SIM7022 AT command manual.  Adjust for your region and network
	  operator.  Use AT+CNBP=? to query supported bands on your hardware.

config MODEM_SIMCOM_SIM7022_DNS_DEFAULT_RECOUNT
	int "Retry count for a DNS query"
	range 0 10
	default 10
	help
	  The number of retries for a DNS lookup.

config MODEM_SIMCOM_SIM7022_DNS_DEFAULT_TIMEOUT
	int "Timeout for a DNS query in milliseconds"
	range 0 60000
	default 20000
	help
	  Timeout for DNS queries in milliseconds.

endif # MODEM_SIM7022
```

## drivers/modem/simcom/y7080e/Kconfig
```kconfig
# SIMCom Y7080E NB-IoT driver options

# Copyright (c) 2026 Anastasios Kaltakis
# SPDX-License-Identifier: Apache-2.0

config MODEM_Y7080E
	bool "SIMCom Y7080E NB-IoT driver"
	depends on DT_HAS_SIMCOM_Y7080E_ENABLED
	depends on !MODEM_CELLULAR
	select MODEM_MODULES
	select MODEM_PIPE
	select MODEM_CHAT
	select MODEM_BACKEND_UART
	select UART_INTERRUPT_DRIVEN if SERIAL_SUPPORT_INTERRUPT
	select RING_BUFFER
	select MODEM_SOCKET
	select NET_OFFLOAD
	select NET_SOCKETS_OFFLOAD
	imply GPIO
	help
	  Driver for the SIMCom Y7080E NB-IoT (Cat-NB1/NB2) module on top of
	  the modem chat/pipe/UART-backend stack, with UDP/TCP socket offload
	  (AT+NSOCR / AT+NSOSTF / AT+NSORF), DNS offload (AT+QDNS) and the
	  PSM sleep/wake sequence of the module (AT+WORKLOCK, RESET pin wake).

if MODEM_Y7080E

config MODEM_SIMCOM_Y7080E_INIT_PRIORITY
	int "Driver init priority"
	default 80

config MODEM_SIMCOM_Y7080E_AUTOSTART
	bool "Power the module on and configure it during driver init"
	help
	  When disabled the driver only prepares the GPIOs and the UART pipe
	  at init and the application powers the module on with
	  mdm_y7080e_power_on(). Keeping this off keeps the boot fast and the
	  module unpowered until the application decides otherwise.

config MODEM_SIMCOM_Y7080E_APN
	string "APN written to the default PDP context (empty = leave the module setting)"
	default ""
	help
	  When set, the driver compares it with the APN of context 0 on every
	  boot and rewrites it (AT+CFUN=0, AT+CGDCONT=0, AT+NV=SAVE) only when
	  it differs. A value the module refuses is not tried again until it
	  changes, the MCU restarts or an attach fails.

	  Firmware 2212B07Y7080E refuses AT+CGDCONT=0 (+CME ERROR: 100) while
	  AT+NCONFIG=AUTOCONNECT is on, its default, and the manual says that
	  mode "will use the APN provided by the network". Leave this empty
	  unless the SIM needs an APN the network does not provide.

config MODEM_SIMCOM_Y7080E_BAND_LIST
	string "NB-IoT band list for AT+NBAND (empty = leave the module setting)"
	default "20,8"
	help
	  Comma separated decimal band list. Compared with AT+NBAND? on every
	  boot and written (with the radio off) only when it differs.

config MODEM_SIMCOM_Y7080E_PSM
	bool "Request Power Saving Mode"
	default y
	help
	  Send AT+CPSMS=1 with the timers below. The module only reaches its
	  1.7 uA PSM current when the network grants the request; the granted
	  timers are decoded from the +CEREG URC (mdm_y7080e_get_psm_timers()).

config MODEM_SIMCOM_Y7080E_PSM_TAU
	string "Requested periodic TAU (T3412) as a GPRS timer 3 octet"
	default "00100001"
	depends on MODEM_SIMCOM_Y7080E_PSM
	help
	  Eight binary digits, bits 8-6 unit (000 10 min, 001 1 h, 010 10 h,
	  011 2 s, 100 30 s, 101 1 min, 110 320 h, 111 deactivated), bits 5-1
	  value. The default requests one hour.

config MODEM_SIMCOM_Y7080E_PSM_ACTIVE_TIME
	string "Requested active time (T3324) as a GPRS timer 2 octet"
	default "00000001"
	depends on MODEM_SIMCOM_Y7080E_PSM
	help
	  Eight binary digits, bits 8-6 unit (000 2 s, 001 1 min, 010 6 min,
	  111 deactivated), bits 5-1 value. The default requests 2 seconds:
	  the module drops into PSM right after the RRC connection is released.

config MODEM_SIMCOM_Y7080E_UDP_SEND_FLAG
	hex "AT+NSOSTF flag for UDP datagrams"
	default 0x200
	range 0x100 0x400
	help
	  0x100 plain send, 0x200 release assistance (the network releases the
	  RRC connection right after this datagram), 0x400 release after the
	  reply to this datagram. 0x200 is the right value for fire-and-forget
	  telemetry: it saves the 20 s inactivity tail per uplink.

config MODEM_SIMCOM_Y7080E_SEND_CONFIRM_TIMEOUT_MS
	int "Milliseconds a blocking UDP send waits for the datagram to go out"
	default 30000
	help
	  AT+NSOSTF only queues a datagram. Sent with a sequence number, the
	  module reports +NSOSTR once it has left the air port (AT manual
	  12.2.7), and a blocking sendto() returns only then: with an error if
	  the module reports a failure or the time runs out. The work lock is
	  therefore never released while a datagram is still queued. 0 sends
	  without a sequence and returns as soon as the datagram is queued.

config MODEM_SIMCOM_Y7080E_MAX_DATA_LENGTH
	int "Largest payload of one send or receive, in bytes"
	default 255
	range 16 1400
	help
	  Payloads travel hex encoded inside one AT line, so this also sizes
	  the chat receive buffer and the command buffer (2 x length + header).

	  The default is what the module's own command line buffer allows:
	  the AT manual (1.4.4) caps a command line at 559 characters, and
	  "AT+NSOSTF=<id>,<ip>,<port>,<flag>,<len>," costs about 45 of them,
	  leaving 514 characters, that is 257 hex encoded bytes. Raising it
	  above 257 makes long sends fail on the module even though
	  AT+NSOSTF itself accepts a length of up to 1400.

config MODEM_SIMCOM_Y7080E_CHAT_BUF_SIZE
	int "modem_chat receive buffer size"
	default 640
	range 256 4096
	help
	  Must exceed the longest response line. An AT+NSORF reply carries
	  2 x MODEM_SIMCOM_Y7080E_MAX_DATA_LENGTH hex characters plus about
	  60 bytes of header, so keep this at least
	  2 x MAX_DATA_LENGTH + 64 (the driver checks it at build time).

config MODEM_SIMCOM_Y7080E_UART_BUF_SIZE
	int "UART backend receive and transmit buffer size (even)"
	default 1024

config MODEM_SIMCOM_Y7080E_ATTACH_TIMEOUT_S
	int "Seconds to wait for network registration and PDN activation"
	default 180

config MODEM_SIMCOM_Y7080E_SLEEP_WAIT_MS
	int "Milliseconds to wait for PSM entry after releasing the work lock"
	default 15000
	help
	  A period in which the module reported RRC or PSM activity (+CSCON,
	  "EXIT PSM") is followed by another one, up to three more: a late
	  uplink is not a refused PSM.

config MODEM_SIMCOM_Y7080E_DNS_TIMEOUT_MS
	int "Timeout for an AT+QDNS lookup, in milliseconds"
	default 20000

config MODEM_SIMCOM_Y7080E_RESETCTL_MODE
	int "AT+RESETCTL mode the driver expects on the RESET pin"
	default 1
	range 0 1
	help
	  1 (factory default): a RESET high pulse shorter than 5 s wakes the
	  module, longer than 6 s resets it. 0: shorter than 15 ms wakes,
	  longer than 20 ms resets. The driver writes the mode into the module
	  when the read-back differs.

endif # MODEM_Y7080E
```

## drivers/sensor/memsic/mmc5983ma/Kconfig
```kconfig
# MMC5983MA 3-axis magnetometer configuration options

# Copyright (c) 2026 Anastasios Kaltakis
# SPDX-License-Identifier: Apache-2.0

menuconfig MMC5983MA
	bool "MMC5983MA 3-axis magnetometer"
	default y
	depends on DT_HAS_MEMSIC_MMC5983MA_ENABLED
	select I2C
	help
	  Enable the driver for the MEMSIC MMC5983MA 18-bit AMR magnetometer
	  with built-in SET/RESET degaussing.

if MMC5983MA

choice MMC5983MA_TRIGGER_MODE
	prompt "Trigger mode"
	default MMC5983MA_TRIGGER_NONE
	help
	  Specify the type of triggering used by the driver.

config MMC5983MA_TRIGGER_NONE
	bool "No trigger"

config MMC5983MA_TRIGGER_GLOBAL_THREAD
	bool "Use global thread"
	depends on GPIO
	depends on $(dt_compat_any_has_prop,$(DT_COMPAT_MEMSIC_MMC5983MA),int-gpios)
	select MMC5983MA_TRIGGER

config MMC5983MA_TRIGGER_OWN_THREAD
	bool "Use own thread"
	depends on GPIO
	depends on $(dt_compat_any_has_prop,$(DT_COMPAT_MEMSIC_MMC5983MA),int-gpios)
	select MMC5983MA_TRIGGER

endchoice

config MMC5983MA_TRIGGER
	bool

config MMC5983MA_THREAD_PRIORITY
	int "Thread priority"
	depends on MMC5983MA_TRIGGER_OWN_THREAD
	default 10
	help
	  Priority of the thread used by the driver to handle interrupts.

config MMC5983MA_THREAD_STACK_SIZE
	int "Thread stack size"
	depends on MMC5983MA_TRIGGER_OWN_THREAD
	default 1024
	help
	  Stack size of the thread used by the driver to handle interrupts.

endif # MMC5983MA
```

## dts/bindings/modem/simcom,sim7022.yaml
```yaml
# Copyright (c) 2025 Metratec GmbH
# SPDX-License-Identifier: Apache-2.0

description: |
  SIMCom SIM7022 NB-IoT modem.

  The SIM7022 is an NB-IoT-only LPWA module connected over UART.
  It uses AT+NETOPEN/NETCLOSE for PDP context management and
  AT+CIPOPEN/CIPSEND/CIPCLOSE/CIPRXGET for socket operations.

  Example DTS node:

    &uart1 {
      status = "okay";

      sim7022: modem {
        compatible = "simcom,sim7022";
        mdm-power-gpios = <&gpio0 10 GPIO_ACTIVE_HIGH>;
      };
    };

compatible: "simcom,sim7022"

include: zephyr,cellular-modem-device.yaml

properties:
  mdm-power-gpios:
    type: phandle-array
    required: true
    description: |
      GPIO connected to the PWRKEY pin of the SIM7022.
      The driver holds it HIGH for 1.5 seconds to toggle
      power on or off (active-high logic).
```

## dts/bindings/modem/simcom,y7080e.yaml
```yaml
# Copyright (c) 2026 Anastasios Kaltakis
# SPDX-License-Identifier: Apache-2.0

description: |
  SIMCom Y7080E NB-IoT (Cat-NB1/NB2) module on a UART.

  The module has no PWRKEY: it boots as soon as VBAT is applied, so
  mdm-power-gpios must drive a load switch on its supply. RESET is active
  high with an internal pull-down; a short high pulse wakes the module from
  PSM, a long one resets it (AT+RESETCTL selects the durations).

  Example:

    &usart2 {
      status = "okay";
      current-speed = <115200>;

      modem: y7080e {
        compatible = "simcom,y7080e";
        mdm-power-gpios = <&gpiob 5 GPIO_ACTIVE_LOW>;
        mdm-reset-gpios = <&gpiob 8 GPIO_ACTIVE_HIGH>;
        mdm-status-gpios = <&gpioa 8 GPIO_ACTIVE_HIGH>;
        mdm-ring-gpios = <&gpiob 9 GPIO_ACTIVE_LOW>;
      };
    };

compatible: "simcom,y7080e"

include: zephyr,cellular-modem-device.yaml

properties:
  mdm-power-gpios:
    required: true
    description: |
      Supply switch of the module. Logical 1 powers the module.

  mdm-reset-gpios:
    required: true
    description: |
      RESET pin, logical 1 = asserted. Doubles as the PSM wake input.

  mdm-status-gpios:
    type: phandle-array
    description: |
      STATUS pin, high once the module firmware is ready. Optional; without
      it the driver waits a fixed time after power-up.

  mdm-ring-gpios:
    description: |
      UART1_RI. The module idles it high and pulses it low for the duration
      set with AT+CMSRI when a URC is waiting, so the line is active low.
      Declaring it only makes the driver arm RI on the module; the driver
      never depends on the pin, because the AT manual states the feature is
      not fully supported without SIMCom involvement.
```
